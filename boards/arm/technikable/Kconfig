## boards/arm/technikable/Kconfig
```kconfig
# SPDX-License-Identifier: MIT

config BOARD_ENABLE_DCDC
	bool "Enable DCDC mode"
	select SOC_DCDC_NRF52X
	default y
	depends on BOARD_TECHNIKABLE
CONFIG_BT_CTLR_TX_PWR_PLUS_8=y
```

## config/west.yml
```yaml
manifest:
  remotes:
    - name: zmkfirmware
      url-base: https://github.com/zmkfirmware
    - name: petejohanson
      url-base: https://github.com/petejohanson
  projects:
    - name: zmk
      remote: petejohanson
      revision: features/soft-off-take-3
      # Switch to below to use ZMK main. Will not work with the technikable@1.1 target until
      # soft off PR https://github.com/zmkfirmware/zmk/pull/2085/ is merged
      #
      # remote: zmkfirmware
      # revision: main
      import: app/west.yml
  self:
    path: config
```
