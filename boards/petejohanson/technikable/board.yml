## boards/petejohanson/technikable/board.yml
```yaml
board:
  name: technikable
  vendor: petejohanson
  socs:
    - name: nrf52840
  revision:
    format: major.minor.patch
    default: 1.1.0
    exact: false
    revisions:
    - name: 1.1.0
    - name: 1.0.0
```
